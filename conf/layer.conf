## conf/layer.conf
```bitbake
# We have a conf and classes directory, append to BBPATH
BBPATH .= ":${LAYERDIR}"

# We have a recipes directory, add to BBFILES
BBFILES += " \
	${LAYERDIR}/recipes*/*/*.bb \
	${LAYERDIR}/recipes*/*/*.bbappend \
	${LAYERDIR}/recipes*/*/*/*.bb \
	${LAYERDIR}/recipes*/*/*/*.bbappend \
"

BBFILE_COLLECTIONS += "meta-glvnd"
BBFILE_PATTERN_meta-glvnd := "^${LAYERDIR}/"
BBFILE_PRIORITY_meta-glvnd = "100"

LAYERSERIES_COMPAT_meta-glvnd = "sumo thud warrior zeus"

LAYERDEPENDS_meta-glvnd = "core"
```
